/*@!Encoding:65001*/
includes
{
  
}

variables
{
    int result;

}

void MainTest()
{
  testModuleTitle("ACC Vehicle Automated Test");
  testModuleDescription("Automated Test for ACC Vehicle");
  testGroupBegin("Functional Tests","functional tests");
  ACCStandbyCheck();
//  ACCoffTest();
//  ACCActivecheck();
//  ACCOff_from_ActiveTest();
//  BrakeSwitch1Test();
//  BrakeSwitch2Test();
//  BrakeDeccelReq_BrakelightTest();
//  ACCOff_ignitioncondition1();
//  ACCOff_ignitioncondition2();
//  ACCTargetSpeedTest();
  CoastResumeTest();
  ACCStateBrakeholdTest();
  ACCstate_at_lessthan_40();
  vehiclespeed_maintained_at_TargerSpeed();
  forwardvehiclefoundTest();
  forwardvehicleNotfoundTest();
  TimegapPlus();
  Timegapminus();
  DriverinterventionTest();
  
  testGroupEnd();
}
testcase ACCStandbyCheck()
{
 testCaseTitle("ACC_TC_001","ACC Standby Test");
  testStep("","Set the Ignition to Run","");
  @ACC_SysVar::sysvar_ignstate=2; //Set ignition to run
    testWaitForTimeout(1000); // Wait for 1 sec
  
  testValidateSignalMatch("Check ACC State = 0(ACC Off State)",ACC_Info::ACC_State,0x0); // Here we are matching the signal value to 0
    testWaitForTimeout(1000); // wait for 1 sec
  setSignal(BCM_Info::VehicleSpeed,60); // set the vehicle speed to 60 km/hr
  
  CruiseSwitch(1); //Press ACC_ON button
      
  testValidateSignalMatch("Check ACC State = 2(ACC Standby)",ACC_Info::ACC_State,0x2); // Here we are matching the signal value to 1 ACC Standby state

    userconfirmation("Does ICM displays ACC Standby ?","ICM displays ACC standby","ICM does not displays the ACC standby");
}

/* testcase ACCoffTest()
{
 testCaseTitle("ACC_TC_002","ACC OFF Test");
  CruiseSwitch(0); //press ACC_OFF button
  
  testValidateSignalMatch("Check ACC State = 0(ACC OFF)",ACC_Info::ACC_State,0x0); // Here we are matching the signal value to 0 ACC Standby state

  userconfirmation("Does ICM displays ACC OFF ?","ICM displays ACC OFF","ICM does not displays the ACC OFF");
}

testcase ACCActivecheck()
{
   testCaseTitle("ACC_TC_003","ACC Active Test");
    
    testValidateSignalMatch("Check ACC State = 0(ACC OFF)",ACC_Info::ACC_State,0x0); // Here we are matching the signal value to 0 ACC Standby state
    testWaitForTimeout(250);
  CruiseSwitch(1); //press ACC_ON buttton
  
  testValidateSignalMatch("Check ACC State = 2(ACC Standby)",ACC_Info::ACC_State,0x2); // Here we are matching the signal value to 1 ACC Standby state
  
  CruiseSwitch(2); //press Set/Accel button
  
    testValidateSignalMatch("Check ACC State = 3(ACC Active)",ACC_Info::ACC_State,0x3); // Here we are matching the signal value to 3 ACC Active state

  userconfirmation("Does ICM displays ACC Active ?","ICM displays ACC Active","ICM is in standby state");
}

testcase ACCOff_from_ActiveTest()
{
   testCaseTitle("ACC_TC_004","ACCOff_from_ActiveTest");

    testValidateSignalMatch("Check ACC State = 3(ACC Active)",ACC_Info::ACC_State,0x3); // Here we are matching the signal value to 3 ACC Active state
    CruiseSwitch(0); //press ACC_OFF button
    testWaitForTimeout(250);
  
    testValidateSignalMatch("Check ACC State = 0(ACC OFF)",ACC_Info::ACC_State,0x0); // Here we are matching the signal value to 0 ACC OFF

    userconfirmation("Does ICM displays ACC OFF ?","ICM displays ACC OFF","ICM does not displays the ACC OFF");
}

testcase BrakeSwitch1Test()
{
   testCaseTitle("ACC_TC_005","BrakeSwitch1Test");
   testValidateSignalMatch("Check ACC State = 0(ACC OFF)",ACC_Info::ACC_State,0x0); // Here we are matching the signal value to 0 ACC OFF
   CruiseSwitch(1); //Press ACC_ON button
  testWaitForTimeout(250);
  
  testValidateSignalMatch("Check ACC State = 2(ACC Standby)",ACC_Info::ACC_State,0x2); // Here we are matching the signal value to 1 ACC Standby state
  
  CruiseSwitch(2); //press Set/Accel button
  
  testValidateSignalMatch("Check ACC State = 3(ACC Active)",ACC_Info::ACC_State,0x3); // Here we are matching the signal value to 3 ACC Active state
  
  brakeswitch(1); //pressing brekeswitch 1

  testValidateSignalMatch("Check ACC State = 2(ACC Standby)",ACC_Info::ACC_State,0x2); // Here we are matching the signal value to 1 ACC Standby state
  
  userconfirmation("Does ICM displays ACC Standby ?","ICM displays ACC standby","ICM is in  ACC Active");
 
}

testcase BrakeSwitch2Test()
{
  testCaseTitle("ACC_TC_006","BrakeSwitch2Test");
  
  testValidateSignalMatch("Check ACC State = 2(ACC Standby)",ACC_Info::ACC_State,0x2); // Here we are matching the signal value to 1 ACC Standby state
 
  CruiseSwitch(2); //press Set/Accel button
  
  testValidateSignalMatch("Check ACC State = 3(ACC Active)",ACC_Info::ACC_State,0x3); // Here we are matching the signal value to 3 ACC Active state
  
  brakeswitch(2); //pressing brekeswitch 1

  testValidateSignalMatch("Check ACC State = 2(ACC Standby)",ACC_Info::ACC_State,0x2); // Here we are matching the signal value to 1 ACC Standby state
  
  userconfirmation("Does ICM displays ACC Standby ?","ICM displays ACC standby","ICM is in  ACC Active");
}

testcase BrakeDeccelReq_BrakelightTest()
{
  testCaseTitle("ACC_TC_007","BrakeDeccelReqTest");
  testValidateSignalMatch("Check ACC State = 2(ACC Standby)",ACC_Info::ACC_State,0x2); // Here we are matching the signal value to 1 ACC Standby state
 
  CruiseSwitch(2); //press Set/Accel button
  
  testValidateSignalMatch("Check ACC State = 3(ACC Active)",ACC_Info::ACC_State,0x3); // Here we are matching the signal value to 3 ACC Active state
   testWaitForTimeout(250);
  //testValidateSignalMatch("Brake Deccel Request = 1",ACC_Info::BrakeDecelRequest,0x1);
  
  userconfirmation("Does Brake light is Glowing ?","Brake light lis glowing","Brake light is not glowing");
  
  result=testWaitForSignalChange(ACC_Info::BrakeDecelRequest,1000);
  {
    if(result==1)
    {
      testStepPass("brakelight is glowing/toggling");
    }
    else{
      testStepFail("brake light is not toggling");
    }
  }
}

testcase ACCOff_ignitioncondition1()
{
  testCaseTitle("ACC_TC_008","ACCOff_ignitioncondition1");
  testValidateSignalMatch("Check ACC State = 3(ACC Active)",ACC_Info::ACC_State,0x3); // Here we are matching the signal value to 3 ACC Active state
  teststep("","Turning OFF the ignition","");
  @ACC_SysVar::sysvar_ignstate=0;  
  testWaitForTimeout(250);
  testValidateSignalMatch("Check ACC State = 0(ACC OFF)",ACC_Info::ACC_State,0x0); // Here we are matching the signal value to 0 ACC OFF
  teststep("","Turning ON the ignition","");
  @ACC_SysVar::sysvar_ignstate=2;  
  testValidateSignalMatch("Check ACC State = 0(ACC OFF)",ACC_Info::ACC_State,0x0); // Here we are matching the signal value to 0 ACC OFF
}

testcase ACCOff_ignitioncondition2()
{
  testCaseTitle("ACC_TC_009","ACCOff_ignitioncondition2");
  testValidateSignalMatch("Check ACC State = 0(ACC OFF)",ACC_Info::ACC_State,0x0); // Here we are matching the signal value to 0 ACC OFF
  CruiseSwitch(2); //press Set/Accel button
  testValidateSignalMatch("Check ACC State = 0(ACC OFF)",ACC_Info::ACC_State,0x0); // Here we are matching the signal value to 0 ACC OFF
}

testcase ACCTargetSpeedTest()
{
  testCaseTitle("ACC_TC_010","ACCTargetSpeedTest");
  testStep("","Set the vehicle speed to 60kmhr");
  setSignal(BCM_Info::VehicleSpeed,60);
  CruiseSwitch(1); //Press ACC_ON button
  testValidateSignalMatch("Check ACC State = 2(ACC Standby)",ACC_Info::ACC_State,0x2); // Here we are matching the signal value to 1 ACC Standby state
  CruiseSwitch(2); //press Set/Accel button
  testValidateSignalMatch("Check ACC State = 3(ACC Active)",ACC_Info::ACC_State,0x3); // Here we are matching the signal value to 3 ACC Active state

  testValidateSignalMatch("Check the Target speed is set to current speed ie 60km/hr",ACC_Info::TargetSpeed,60);
}
*/
testcase CoastResumeTest()
{
  
  testCaseTitle("ACC_TC_011","CoastResumeTest");
  CruiseSwitch(2); //press Set/Accel button

  testValidateSignalMatch("Check ACC State = 3(ACC Active)",ACC_Info::ACC_State,0x3); // Here we are matching the signal value to 3 ACC Active state
  CruiseSwitch(3); //Press Coast button
  setSignal(ACC_Info::TargetSpeed,80); //change to vehicle speed

  testValidateSignalMatch("Check ACC State = 2(ACC Standby)",ACC_Info::ACC_State,0x2); // Here we are matching the signal value to 1 ACC Standby state
  CruiseSwitch(4); //Press Resume button
  testValidateSignalMatch("Check ACC State = 3(ACC Active)",ACC_Info::ACC_State,0x3); // Here we are matching the signal value to 3 ACC Active state
  setSignal(BCM_Info::VehicleSpeed,80); //change to vehicle speed
  testValidateSignalMatch("Check the Target speed is set to current speed ie 60km/hr",ACC_Info::TargetSpeed,60);

}

testcase ACCStateBrakeholdTest()
{
  testCaseTitle("ACC_TC_012","ACCStateBrakeholdTest");
  testValidateSignalMatch("Check ACC State = 3(ACC Active)",ACC_Info::ACC_State,0x3); // Here we are matching the signal value to 3 ACC Active state
  CruiseSwitch(0); //press ACC_OFF button
  testWaitForTimeout(250);
  CruiseSwitch(1); //Press ACC_ON button
  testWaitForTimeout(250);
  testValidateSignalMatch("Check ACC State = 2(ACC Standby)",ACC_Info::ACC_State,0x2); // Here we are matching the signal value to 1 ACC Standby state
  
  testStep("","Press and hold the Brakeswitch1","");
  setSignal(ICM_Info::BrakeSwitch1,1);
  CruiseSwitch(2); //press Set/Accel button

  testValidateSignalMatch("Check ACC State = 2(ACC Standby)",ACC_Info::ACC_State,0x2); // Here we are matching the signal value to 1 ACC Standby state
  userconfirmation("Does ICM displays ACC Standby ?","ICM displays ACC standby","ICM does not displays the ACC standby");
  
  setSignal(ICM_Info::BrakeSwitch1,0);  
}

//ACC_TC_013 is same as 12 so we ignored

testcase ACCstate_at_lessthan_40()
{
  testCaseTitle("ACC_TC_014","ACCstate_at_lessthan_40");

  testValidateSignalMatch("Check ACC State = 2(ACC Standby)",ACC_Info::ACC_State,0x2); // Here we are matching the signal value to 1 ACC Standby state
  setSignal(BCM_Info::VehicleSpeed,35); //change to vehicle speed leass than 40km/hr
  testWaitForTimeout(250);

  CruiseSwitch(2); //press Set/Accel button
  testValidateSignalMatch("Check ACC State = 2(ACC Standby)",ACC_Info::ACC_State,0x2); // Here we are matching the signal value to 1 ACC Standby state
  userconfirmation("Does ICM displays ACC Standby ?","ICM displays ACC standby","ICM does not displays the ACC standby");
}

testcase vehiclespeed_maintained_at_TargerSpeed()
{
  testCaseTitle("ACC_TC_015","vehiclespeed_maintained_at_TargerSpeed");
  
  testValidateSignalMatch("Check ACC State = 2(ACC Standby)",ACC_Info::ACC_State,0x2); // Here we are matching the signal value to 1 ACC Standby state
  setSignal(BCM_Info::VehicleSpeed,70);
  CruiseSwitch(2); //press Set/Accel button
  testStep("","Verify the vehicle speed should maintained between  + or - 5km/hr  of Target Speed");
  testValidateSignalInRange("Validating the vehicle speed is in range",BCM_Info::VehicleSpeed,70,75);
  userconfirmation("Does the vehicle speed is maintained btw Target","yes the speed is maintained","No the vehicle speed is not maintained btw Targetspeed");
}

testcase forwardvehiclefoundTest()
{
  testCaseTitle("ACC_TC_016","forwardvehiclefoundTest");
  
  testValidateSignalMatch("Check ACC State = 3(ACC Active)",ACC_Info::ACC_State,0x3); // Here we are matching the signal value to 3 ACC Active state
 // testValidateSignalMatch("Check the vehicle speed =70km/hr",BCM_Info::VehicleSpeed,70);
  testValidateSignalInRange("Validating the vehicle speed is in range",BCM_Info::VehicleSpeed,70,75);

  teststep("","introducing the forward vehicle");
  @ACC_SysVar::sysvar_frwd_vehicle_stat=1;
  testWaitForTimeout(5000);
  testValidateSignalInRange("Validating the Target speed is less than the vehicle speed ?",ACC_Info::TargetSpeed,41,64);
  result=testWaitForSignalChange(BCM_Info::VehicleSpeed,500);
  
  if (result==1)
  {
    testStepPass("","Yes the target speed is decreased");
  }
  
}

testcase forwardvehicleNotfoundTest()
{
  testCaseTitle("ACC_TC_017","forwardvehicleNotfoundTest");
  testValidateSignalMatch("Check ACC State = 3(ACC Active)",ACC_Info::ACC_State,0x3); // Here we are matching the signal value to 3 ACC Active state
  teststep("","forward vehicle not found");
  @ACC_SysVar::sysvar_frwd_vehicle_stat=0;  
  testWaitForTimeout(5000); 
  testValidateSignalInRange("Validating the vehicle speed is in range",BCM_Info::VehicleSpeed,70,75);
  userconfirmation("Does the vehicle speed is maintained btw Target","yes the speed is maintained","No the vehicle speed is not maintained btw Targetspeed");
  
}

testcase TimegapPlus()
{
  testCaseTitle("ACC_TC_018","TimegapPlus");
  teststep("","Press time gap +");
  CruiseSwitch(5); //Press TimeGap+
  testWaitForTimeout(500);
  @ACC_SysVar::sysvar_frwd_vehicle_stat=1;
  testWaitForTimeout(5000); 
  testValidateSignalInRange("Validating the Target speed is less than the vehicle speed ?",ACC_Info::TargetSpeed,10,40);
  @ACC_SysVar::sysvar_frwd_vehicle_stat=0;
  testWaitForTimeout(5000); 
}
testcase Timegapminus()
{
  testCaseTitle("ACC_TC_019","Timegapminus");
  teststep("","Press time gap -");
  CruiseSwitch(6); //Press TimeGap-
  CruiseSwitch(6); //Press TimeGap-
  @ACC_SysVar::sysvar_frwd_vehicle_stat=1;
  testWaitForTimeout(6000); 
  testValidateSignalInRange("Validating the Target speed is less than the vehicle speed ?",ACC_Info::TargetSpeed,100,200);
 //@ACC_SysVar::sysvar_frwd_vehicle_stat=0;
//  testWaitForTimeout(4000); 
}

testcase DriverinterventionTest()
{
  testCaseTitle("ACC_TC_020","DriverinterventionTest");
  userconfirmation("Is Forward vehicle status is still ON","Yes, Forward vehicle is introduced","Forward vehicle is not introduced");
  @ACC_SysVar::sysvar_frwd_vehicle_stat=0;
  testWaitForTimeout(500);
  CruiseSwitch(5); //Press TimeGap+
  CruiseSwitch(5); //Press TimeGap+
  CruiseSwitch(5); //Press TimeGap+
  testWaitForTimeout(250);
  @ACC_SysVar::sysvar_frwd_vehicle_stat=1;
  testWaitForTimeout(5000); 
  testValidateSignalInRange("Validating the Target speed is less than the vehicle speed ?",ACC_Info::TargetSpeed,0,40);
    userconfirmation("Does ICM displays Driver Intervention Required msg","Yes, ICM displays the msg","ICM doesnt showing the msg");


}

testfunction CruiseSwitch(int switchvalue)
{
  teststep("","Press cruise switch %d",switchvalue,"");
  setSignal(ICM_Info::CruiseSwitchRequest,switchvalue);
  testWaitForTimeout(250);
  setSignal(ICM_Info::CruiseSwitchRequest,0x07);
}

testfunction userconfirmation(char usrmsg1[],char usrmsg2[],char usrmsg3[])
{
   result=testWaitForTesterConfirmation(usrmsg1); // Asking the tester to confirm the ICM displays 
    if(result==1)
    {
      testStep("","Check User Confirmation","");
      testStepPass(usrmsg2);
    }
    else
    {
      testStep("","Check User Confirmation","");
      testStepFail(usrmsg3);
    }
}

testfunction brakeswitch(int brakeswitch)
{
 if(brakeswitch==1)
 {
  teststep("","Press Brake switch %d",brakeswitch,"");
   
   setSignal(ICM_Info::BrakeSwitch1,1);
   testWaitForTimeout(250);
   setSignal(ICM_Info::BrakeSwitch1,0);
 }
 else if (brakeswitch==2)
 {
  teststep("","Press Brake switch %d",brakeswitch,"");
   
   setsignal(ECM_Info::BrakeSwitch2,1);
   testWaitForTimeout(250);
   setSignal(ECM_Info::BrakeSwitch2,0);
 }
}