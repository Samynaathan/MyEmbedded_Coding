/*@!Encoding:65001*/
includes
{
  
}

variables
{
  
}
on start
{
  TalkNM();
}

on sysvar ACC_SysVar::ECMNode_on_off
{
  if(@this==1)
    ILControlStop();
  else
    ILControlStart();  
}

on message 0x503
{
  @NM::ECM_Successor=this.byte(0);
  @NM::ECM_Alive=this.byte(1) & 0x1;
  @NM::ECM_Ring=(this.byte(1)>>1) & 0x1;  
  @NM::ECM_Limphome=(this.byte(1)>>2) & 0x1;
  @NM::ECM_SleepInd=(this.byte(1)>>4) & 0x1;
  @NM::ECM_SleepAck=(this.byte(1)>>5) & 0x1;
} 

on sysvar NM::ECM_SleepWakeup
{
  if(@this)
  {
    GotoMode_BusSleep();
  }
  else
  {
    GotoMode_Awake();
  }
}

on sysvar NM::ECM_Con_Dis
{
  if(@this)
  {
    SilentNM();
    ILControlStop();
  }
  else
  {
    TalkNM();
    ILControlStart();
  }
}

on message CAN1.*
{
  message CAN2.* m;
 // message CAN1.* m1;
  
  if(this.CAN && (this.id==0x167||this.id==0x312))
  {
    m.id=0x78;
    m.dlc=4;
    
    if(this.id == 0x167)
    {
       m.byte(0)=this.byte(0);
    }
    if(this.id == 0x312)
    {
      m.byte(1)=this.byte(0)>>0x7;
    }
    //m=this;
    output(m);
  }
}

