/*@!Encoding:65001*/
includes
{

}

variables
{
  
}
on start
{
  TalkNM();
}

on message ACC_Info
{
  if (getSignal(ACC_Info::ACCDriverInfo)==0)
  {
    sysSetVariableString(sysvar::ACC_SysVar::sysvar_ICM_LCD,"ACC_Off");
  }
  else if (getSignal(ACC_Info::ACCDriverInfo)==2)
   {
    sysSetVariableString(sysvar::ACC_SysVar::sysvar_ICM_LCD,"ACC_Standby");
  }
  else if (getSignal(ACC_Info::ACCDriverInfo)==3)
   {
    sysSetVariableString(sysvar::ACC_SysVar::sysvar_ICM_LCD,"ACC_Active");
  }
  else if (getSignal(ACC_Info::ACCDriverInfo)==4)
  {
    sysSetVariableString(sysvar::ACC_SysVar::sysvar_ICM_LCD,"Driver Interv is req");
  }
  else if (getSignal(ACC_Info::ACCDriverInfo)==5)
  {
    sysSetVariableString(sysvar::ACC_SysVar::sysvar_ICM_LCD,"ACC_fault");
  }
}

on sysvar ACC_SysVar::ICMNode_on_off
{
  if(@this==1)
    ILControlStop();
  else
    ILControlStart();
}

on message 0x504
{
  @NM::ICM_Successor=this.byte(0);
  @NM::ICM_Alive=this.byte(1) & 0x1;
  @NM::ICM_Ring=(this.byte(1)>>1) & 0x1;  
  @NM::ICM_Limphome=(this.byte(1)>>2) & 0x1;
  @NM::ICM_SleepInd=(this.byte(1)>>4) & 0x1;
  @NM::ICM_SleepAck=(this.byte(1)>>5) & 0x1;
} 

on sysvar NM::ICM_SleepWakeup
{
  if(@this)
  {
    GotoMode_BusSleep();
  }
  else
  {
    GotoMode_Awake();
  }
}

on sysvar NM::ICM_Con_Dis
{
  if(@this)
  {
    SilentNM();
    ILControlStop();
  }
  else
  {
    TalkNM();
    ILControlStart();
  }
}


